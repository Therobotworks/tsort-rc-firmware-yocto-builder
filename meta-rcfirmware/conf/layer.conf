## meta-rcfirmware/conf/layer.conf
```bitbake
# We have a conf and classes directory, add to BBPATH
BBPATH .= ":${LAYERDIR}"

# We have recipes-* directories, add to BBFILES
BBFILES += "${LAYERDIR}/recipes-*/*/*.bb \
            ${LAYERDIR}/recipes-*/*/*.bbappend"

BBFILE_COLLECTIONS += "meta-rcfirmware"
BBFILE_PATTERN_meta-rcfirmware = "^${LAYERDIR}/"
BBFILE_PRIORITY_meta-rcfirmware = "6"

LAYERDEPENDS_meta-rcfirmware = "core"
LAYERSERIES_COMPAT_meta-rcfirmware = "scarthgap"
```

## meta-rcfirmware/conf/machine/mustangnxp.conf
```bitbake
#@TYPE: Machine
#@NAME: Mustang NXP (i.MX8M Plus EVK)
#@SOC: i.MX8MP
#@DESCRIPTION: Machine configuration for Mustang based on NXP i.MX8M Plus EVK

require conf/machine/imx8mp-lpddr4-evk.conf

# Autoload NXP Wi-Fi kernel driver
KERNEL_MODULE_AUTOLOAD += "moal"
```
